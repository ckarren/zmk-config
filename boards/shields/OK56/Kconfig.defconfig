## boards/shields/OK56/Kconfig.defconfig
```kconfig
if SHIELD_OK56_LEFT

config ZMK_KEYBOARD_NAME
    default "OK56"

config ZMK_SPLIT_ROLE_CENTRAL
    default y

endif

if SHIELD_OK56_LEFT || SHIELD_OK56_RIGHT

config ZMK_SPLIT
    default y

endif
CONFIG_BT_CTLR_TX_PWR_PLUS_8=y
CONFIG_ZMK_BLE_EXPERIMENTAL_CONN=y
```

## boards/shields/OK56/Kconfig.shield
```kconfig
config SHIELD_OK56_LEFT
    def_bool $(shields_list_contains,OK56_left)
config SHIELD_OK56_RIGHT
    def_bool $(shields_list_contains,OK56_right)
```
